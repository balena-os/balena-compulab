## layers/meta-balena-compulab/conf/layer.conf
```bitbake
BBPATH .= ":${LAYERDIR}"

BBFILES += "${LAYERDIR}/recipes-*/*/*.bb \
            ${LAYERDIR}/recipes-*/*/*.bbappend"

BBFILE_COLLECTIONS += "balena-compulab"
BBFILE_PATTERN_balena-compulab := "^${LAYERDIR}/"
BBFILE_PRIORITY_balena-compulab = "1337"
LAYERSERIES_COMPAT_balena-compulab = "warrior"

BBMASK += "chromium/chromium_%.bbappend"
BBMASK += "firmware-imx/firmware-imx_7.5.bb"
BBMASK += "chromium/chromium-ozone-wayland_%.bbappend"
BBMASK += "imx/meta-bsp/recipes-connectivity/openssl/openssl_1.1.1b.bbappend"
BBMASK += "imx/meta-bsp/recipes-kernel/linux-firmware/linux-firmware_git.bbappend"
BBMASK += "imx/meta-bsp/recipes-bsp/imx-atf/imx-atf_2.0.bb"
BBMASK += "imx/meta-bsp/recipes-bsp/imx-mkimage/*"

SERIAL_CONSOLES_cl-som-imx8 = "115200;ttymxc2"

# These versions are used because the ModemManager
# update in meta-balena cannot be built with
# Meson older than 0.53.0. See internal
# discussion https://balena.zulipchat.com/#narrow/stream/345889-balena-io.2Fos/topic/Compulab.20IOT-gate-imx8/near/374666230
PREFERRED_VERSION_libmbim = "1.26.2"
PREFERRED_VERSION_libqmi = "1.30.2"
PREFERRED_VERSION_modemmanager = "1.18.4"
```

## layers/meta-balena-compulab/conf/machine/cl-imx8-v1-1.conf
```bitbake
#@TYPE: Machine
##@NAME: cl-som-imx8-v1_1
##@DESCRIPTION: Machine configuration for the cl-som-imx8 revison 1.1

MACHINEOVERRIDES = "cl-som-imx8:${MACHINE}"
include conf/machine/cl-som-imx8.conf

KERNEL_DEVICETREE = "compulab/cl-imx8-v1-1.dtb"

# Set u-boot DTB
UBOOT_DTB_NAME = "cl-imx8-v1-1.dtb"
```

## layers/meta-balena-compulab/conf/machine/etcher-pro.conf
```bitbake
#@TYPE: Machine
#@NAME: Etcher Pro
#@DESCRIPTION: Balena Etcher Pro board using Compulab CL-SOM-IMX8

MACHINEOVERRIDES = "cl-som-imx8:${MACHINE}"
include conf/machine/cl-som-imx8.conf

KERNEL_DEVICETREE = "compulab/sbc-imx8-no-wp.dtb"

MACHINE_ESSENTIAL_EXTRA_RRECOMMENDS += "gov-switch watchdog-config mesa "

SERIAL_CONSOLES = "115200;ttymxc2"

CONNECTIVITY_FIRMWARES_remove = " \
    linux-firmware-bcm43143 \
"
```

## layers/meta-resin-compulab/conf/layer.conf
```bitbake
BBPATH .= ":${LAYERDIR}"

BBFILES += "${LAYERDIR}/recipes-*/*/*.bb \
            ${LAYERDIR}/recipes-*/*/*.bbappend"

BBFILE_COLLECTIONS += "resin-compulab"
BBFILE_PATTERN_resin-compulab := "^${LAYERDIR}/"
BBFILE_PRIORITY_resin-compulab = "1337"
LAYERSERIES_COMPAT_resin-compulab = "sumo"

BBMASK ?= ".*/meta-compulab/recipes-browser/"
```
